## nixos-configurations/pea/fitimage.its
```
/dts-v1/;

/ {
	description = "Chrome OS kernel image";

	images {
		kernel-1 {
			description = "kernel";
			data = /incbin/("kernel.lzma");
			type = "kernel_noload";
			arch = "arm64";
			os = "linux";
			compression = "lzma";
			load = <0>;
			entry = <0>;
		};

		ramdisk-1 {
			description = "ramdisk";
			data = /incbin/("initrd");
			type = "ramdisk";
			arch = "arm64";
			os = "linux";
			compression = "none";
			hash-1 {
				algo = "sha256";
			};
		};

		fdt-1 {
			description = "devicetree";
			data = /incbin/("fdt");
			type = "flat_dt";
			arch = "arm64";
			compression = "none";
			hash-1 {
				algo = "sha256";
			};
		};
	};

	configurations {
		default = "conf-1";
		conf-1 {
			kernel = "kernel-1";
			fdt = "fdt-1";
			ramdisk = "ramdisk-1";
		};
	};
};
```

## nixos-configurations/pea/tinyboot.its
```
/dts-v1/;

/ {
	description = "Coreboot Linux Payload";

	images {
		kernel-1 {
			description = "kernel";
			data = /incbin/("kernel.lzma");
			type = "kernel";
			arch = "arm64";
			os = "linux";
			compression = "lzma";
			load = <0>;
			entry = <0>;
			hash-1 {
				algo = "sha256";
			};
		};

		ramdisk-1 {
			description = "ramdisk";
			data = /incbin/("initrd");
			type = "ramdisk";
			arch = "arm64";
			os = "linux";
			compression = "none";
			hash-1 {
				algo = "sha256";
			};
		};

		fdt-1 {
			description = "devicetree";
			data = /incbin/("dtb");
			type = "flat_dt";
			arch = "arm64";
			compression = "none";
			hash-1 {
				algo = "sha256";
			};
		};
	};

	configurations {
		default = "conf-1";
		conf-1 {
			kernel = "kernel-1";
			fdt = "fdt-1";
			ramdisk = "ramdisk-1";
		};
	};
};
```

## overlays/by-name/chromeos-kpart/fitimage-x86_64.its
```
/dts-v1/;

/ {
	description = "Chrome OS kernel image";

	images {
		kernel-1 {
			description = "kernel";
			data = /incbin/("kernel.lzma");
			type = "kernel_noload";
			arch = "x86_64";
			os = "linux";
			compression = "lzma";
			load = <0>;
			entry = <0>;
			hash-1 {
				algo = "sha256";
			};
		};

		ramdisk-1 {
			description = "ramdisk";
			data = /incbin/("initrd");
			type = "ramdisk";
			compression = "none";
			hash-1 {
				algo = "sha256";
			};
		};
	};

	configurations {
		default = "conf-1";
		conf-1 {
			kernel = "kernel-1";
			ramdisk = "ramdisk-1";
		};
	};
};
```

## overlays/kernels/linuxboot.its
```
/*
 * Simple U-Boot uImage source file containing a single kernel and FDT blob
 */

/dts-v1/;

/ {
	description = "Simple image with single Linux kernel and FDT blob";
	#address-cells = <1>;

	images {
		kernel {
			description = "Vanilla Linux kernel";
			data = /incbin/("Image.lzma");
			type = "kernel";
			arch = "arm64";
			os = "linux";
			compression = "lzma";
			hash-1 {
				algo = "crc32";
			};
		};
		fdt-1 {
			description = "Flattened Device Tree blob";
			data = /incbin/("target.dtb");
			type = "flat_dt";
			arch = "arm64";
			compression = "none";
			hash-1 {
				algo = "crc32";
			};
		};
		ramdisk-1 {
			description = "Compressed Initramfs";
			data = /incbin/("initramfs.cpio.xz");
			type = "ramdisk";
			arch = "arm64";
			os = "linux";
			compression = "none";
			hash-1 {
				algo = "sha1";
			};
		};
	};

	configurations {
		default = "conf-1";
		conf-1 {
			description = "Boot Linux kernel with FDT blob";
			kernel = "kernel";
			fdt = "fdt-1";
			ramdisk = "ramdisk-1";
		};
	};
};
```

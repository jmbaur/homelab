## nixos-configurations/squash/tinyboot.its
```
/dts-v1/;

/ {
	description = "tinyboot falcon mode payload";

	images {
		kernel-1 {
			description = "kernel";
			data = /incbin/("kernel");
			type = "kernel";
			arch = "arm";
			os = "linux";
			compression = "none";
			/*
			 * Falcon mode does no bootm-style relocation, so the
			 * fdt and ramdisk have to sit where the decompressed
			 * kernel (which lands at 0x8000) cannot reach them.
			 */
			load = <0x00800000>;
			entry = <0x00800000>;
			hash-1 {
				algo = "sha256";
			};
		};

		ramdisk-1 {
			description = "ramdisk";
			data = /incbin/("initrd");
			type = "ramdisk";
			arch = "arm";
			os = "linux";
			compression = "none";
			load = <0x02200000>;
			hash-1 {
				algo = "sha256";
			};
		};

		fdt-1 {
			description = "devicetree";
			data = /incbin/("dtb");
			type = "flat_dt";
			arch = "arm";
			compression = "none";
			load = <0x02000000>;
			hash-1 {
				algo = "sha256";
			};
		};
	};

	configurations {
		default = "conf-1";
		conf-1 {
			kernel = "kernel-1";
			fdt = "fdt-1";
			ramdisk = "ramdisk-1";
		};
	};
};
```

## nixos-modules/fit/kernel.its
```
/dts-v1/;

/ {
	description = "@description@";
	#address-cells = <1>;

	images {
		kernel {
			description = "kernel";
			data = /incbin/("./kernel.lzma");
			type = "kernel";
			arch = "@arch@";
			os = "linux";
			compression = "lzma";
			load = <@loadAddress@>;
			entry = <@loadAddress@>;
			hash {
				algo = "crc32";
			};
		};

		fdt {
			description = "dtb";
			data = /incbin/("./dtb");
			type = "flat_dt";
			arch = "@arch@";
			compression = "none";
			hash {
				algo = "crc32";
			};
		};

		initrd {
			description = "initrd";
			data = /incbin/("initrd");
			type = "ramdisk";
			arch = "@arch@";
			os = "linux";
			compression = "none";
			hash {
				algo = "crc32";
			};
		};
	};

	configurations {
		default = "boot";

		boot {
			description = "@description@";
			kernel = "kernel";
			fdt = "fdt";
			ramdisk = "initrd";

			signature {
				algo = "crc32";
				key-name-hint = "dev";
				sign-images = "kernel", "fdt", "initrd";
			};
		};
	};
};
```
